## base_external/Config.in
```kconfig
menu "aesd assignments"
  source "$BR2_EXTERNAL_aesd_PATH/package/aesd-assignments/Config.in"
  source "$BR2_EXTERNAL_aesd_PATH/package/ldd/Config.in"
endmenu
```

## base_external/package/ldd/Config.in
```kconfig
config BR2_PACKAGE_LDD
	bool "aesd-ldd-assignments"
	help
	  Build LDD module driver. 
```
